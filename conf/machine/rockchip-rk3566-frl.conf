## conf/machine/rockchip-rk3566-frl.conf
```bitbake
# Copyright (c) 2020, Rockchip Electronics Co., Ltd
# Released under the MIT license (see COPYING.MIT for the terms)

#@TYPE: Machine
#@NAME: RK3566 FRL

require conf/machine/include/rk356x.inc


UBOOT_MACHINE = "rk3568_defconfig"

KBUILD_DEFCONFIG := "rockchip_linux_defconfig"
KERNEL_DEVICETREE := "rockchip/rk3566-frl-v1.0.dtb"

PREFERRED_VERSION_linux-rockchip := "6.1%"
LINUXLIBCVERSION := "6.1-custom%"

RK_WIFIBT_RRECOMMENDS = " \
	rkwifibt-firmware-ap6256-wifi \
	rkwifibt-firmware-ap6256-bt \
	brcm-tools \
"

DISTRO_FEATURES:append = " bluetooth"
IMAGE_INSTALL:append = " \
	${RK_WIFIBT_RRECOMMENDS} \
	kernel-modules \
	linux-firmware \
	alsa-utils \
	wpa-supplicant iw rfkill \
	bluez5 \
	dbus \
	evtest \
"
```

## conf/machine/rockchip-rk3566-opi3b.conf
```bitbake
# Copyright (c) 2020, Rockchip Electronics Co., Ltd
# Released under the MIT license (see COPYING.MIT for the terms)

#@TYPE: Machine
#@NAME: RK3566 OrangePi 3B

require conf/machine/include/rk356x.inc


UBOOT_MACHINE = "rk3568_defconfig"

KBUILD_DEFCONFIG := "rockchip_linux_defconfig"
KERNEL_DEVICETREE := "rockchip/rk3566-opi3b-v1.0.dtb"

PREFERRED_VERSION_linux-rockchip := "6.1%"
LINUXLIBCVERSION := "6.1-custom%"

IMAGE_INSTALL:append = " \
	kernel-modules \
	wpa-supplicant iw rfkill \
"
```
