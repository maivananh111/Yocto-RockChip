## meta-rockchip/conf/machine/opi3b-rk3566.conf
```bitbake
#@TYPE: Machine
#@NAME: Orange Pi 3B


require conf/machine/include/rk3566.inc
#KERNEL_DEVICETREE = "rockchip/rk3566-radxa-zero-3w.dtb"
KERNEL_DEVICETREE = "rockchip/rk3566-orangepi-3b-v2.1.dtb"
UBOOT_MACHINE = "orangepi-3b-rk3566_defconfig"

PREFERRED_PROVIDER_virtual/xserver ?= "xserver-xorg"
EXTRA_IMAGEDEPENDS += "virtual/bootloader"
WKS_FILE = "rockchip.wks"
IMAGE_FSTYPES += "tar.bz2 jffs2 wic wic.bmap wic.gz"
EXTRA_IMAGECMD:jffs2 = "-lnp "

MACHINE_EXTRA_RRECOMMENDS = "kernel-modules"
MACHINE_ESSENTIAL_EXTRA_RDEPENDS += "kernel-image kernel-devicetree"
```
